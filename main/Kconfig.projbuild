## main/Kconfig.projbuild
```kconfig
menu "DIY Power PCB Configuration"

    orsource "$IDF_PATH/examples/common_components/env_caps/$IDF_TARGET/Kconfig.env_caps"
    menu "ADC 1 configurations"

    config U_SENSE_ADC
        int "Voltage sensing ADC1 number"
        default 5
        help
            ADC1 number of the Input-Voltage-Sensing pin
    config I_SENSE_ADC
        int "Current sensing ADC1 number"
        default 7
        help
            ADC1 number of the Current-Sensing pin at the Shunt
    config I_SENSE_U_V_W_ADC
        string "Current sensing ADC1 numbers of U, V, W"
        default "6, 3, 0"
        help
            ADC1 numbers of the current sensing pins at U,V and W. Write seperated by a comma. example:"34,29,36"
    config TORQUE_ADC
        int "Torque sensing ADC1 number"
        default 4
        help
            GPIO numbers of the torque sensing pin"
    endmenu
    menu "Highside pin configurations (HIN)"
    config  HIN_U_V_W_GPIO
        string  "Highside GPIO pins (HIN U, V, W)"
        default "26, 14, 13"
        help
            GPIO numbers of the Highside controling pins, seperate by comma!
    config ENABLE_PWM_HIN
        bool "Enable PWM for Highsides"
        default y
        help
            Enable PWM on the Highside Switches, probably mendatory because of bootstrap capacitors
    if ENABLE_PWM_HIN
    config FREQ_PWM_HIN
        int "frequency"
        range 20000 60000
        default 20000
        help
            The base Frequency of the PWM in Hz min: 20KHz max: 60KHz
    config DUTY_PWM_HIN
        int "duty cycle"
        range 0 100
        default 50
        help
            The inital duty-cycle
    endif
    endmenu
    menu "Lowside pin configurations (LIN)"
    config  LIN_U_V_W_GPIO
        string  "Lowside GPIO pins (LIN U, V, W)"
        default "25, 27, 12"
        help
            GPIO numbers of the Lowside controling pins, seperate by comma!
    config ENABLE_PWM_LIN
        bool "Enable PWM for Lowsides"
        default n
        help
            Enable PWM on the Lowside Switches, probably not mendatory because of Highside PWM more important
    if ENABLE_PWM_LIN
    config FREQ_PWM_LIN
        int "frequency"
        range 20000 60000
        default 20000
        help
            The base Frequency of the PWM in Hz min: 20KHz max: 60KHz
    config DUTY_PWM_LIN
        int "duty cycle"
        range 0 100
        default 50
        help
            The inital duty-cycle
    endif
    endmenu
    menu "Hall Sensor pin configurations"
    config  HALL_A_B_C_GPIO
        string  "Hallsensor GPIO pins (A, B, C)"
        default "4, 16, 17"
        help
            GPIO numbers of the pins connected to the Hallsensors, seperate by comma!
    endmenu
    menu "Input pin configurations"
    config IN_ENCODER_GPIO
        string "turning encoder(on board) GPIO pins: A, B, Button"
        default "3, 2, 23"
        help
            GPIO numbers of the pins connected to A,B and the button of the encoder

    config BUTTON_GPIO
        int "button GPIO pin"
        default 1
        help
            GPIO number of the pin connected to the button on the pcb

    config EXT_ENCODER_GPIO
        string "encoder(at motor) GPIO pins: Indx, Left, Right"
        default "16, 18, 5"
        help
            GPIO numbers of the pins connected to the Logic connected to the encoder at the motor
    config RFE_GPIO
        int "RFE GPIO pin"
        default 15
        help
            GPIO number of the pin connected to the RFE pin of the Bridge
    endmenu

    config BLINK_PERIOD
        int "Blink period in ms"
        range 10 3600000
        default 1000
        help
            Define the blinking period in milliseconds.
    
endmenu
```
